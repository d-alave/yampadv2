## config/west.yml
```yaml
manifest:
  remotes:
    - name: zmkfirmware
      url-base: https://github.com/zmkfirmware
  projects:
    - name: zmk
      remote: zmkfirmware
      revision: e47185ad95c0b8ac2ebe1043c8c6c4b7a1b2c8db  # Jan 8, 2025 - stable
      import: app/west.yml
  self:
    path: config
```
